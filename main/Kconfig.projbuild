## main/Kconfig.projbuild
```kconfig
menu "Hermes Nabu"

    menu "Defaults (overridable from the serial console)"
        config HG_DEFAULT_NAME
            string "Device name"
            default "Hermes Nabu"
        config HG_DEFAULT_SERVER_URL
            string "Hermes gadget endpoint"
            default ""
            help
                ws://<hermes-host>:8765/gadget  (run 'hermes gadget info' on the host).
                Leave empty to configure it over serial: set server <url>
        config HG_DEFAULT_ACCESS_TOKEN
            string "Access token (only if GADGET_ACCESS_TOKEN is set on the host)"
            default ""
        config HG_DEFAULT_WIFI_SSID
            string "Wi-Fi SSID"
            default ""
        config HG_DEFAULT_WIFI_PASSWORD
            string "Wi-Fi password"
            default ""
    endmenu

endmenu
```
